## sysdrv/source/buildroot_external/Config.in
```kconfig
source "$BR2_EXTERNAL_RV1106_PATH/package/rkmpp/Config.in"
source "$BR2_EXTERNAL_RV1106_PATH/package/rkrga/Config.in"
source "$BR2_EXTERNAL_RV1106_PATH/package/rkffmpeg/Config.in"
```

## sysdrv/source/buildroot_external/package/rkffmpeg/Config.in
```kconfig
config BR2_PACKAGE_RKFFMPEG
        bool "rkffmpeg"
        help
            rockchip rkffmpeg
```

## sysdrv/source/buildroot_external/package/rkmpp/Config.in
```kconfig
config BR2_PACKAGE_RKMPP
        bool "rkmpp"
        help
            rockchip mpp
```

## sysdrv/source/buildroot_external/package/rkrga/Config.in
```kconfig
config BR2_PACKAGE_RKRGA
        bool "rkrga"
        help
            rockchip rga
```
